## board/novatek/common/Kconfig
```kconfig
config NVT_IVOT_SOC
	bool "Novatek IVOT series soc"
	help
	  This option can be used to enable ivot features.

if !NVT_IVOT_SOC
menu "Novatek Turnkey Features"

choice
	prompt "Novate TV SOC Type Select"
	default NT72172

config NT72172
	bool "Novatek NT72172 TV SOC"
	help 
	Novatek NT72172 TV SOC

config NT72673
	bool "Novatek NT72673 TV SOC"
	help 
	Novatek NT72673 TV SOC

config NT72671
	bool "Novatek NT72671 TV SOC"
	help 
	Novatek NT72671 TV SOC

endchoice

choice 
    	prompt "Novatek SOC project select" 

config NT72172_A32_EVB
	bool "Novatek NT72172 A32 Evulation Board"	

config NT72172_A64_EVB
 	bool "Novatek NT72172 A64 Evulation Board"

config NT72172_A64_TK_ANDROID
	bool "Novatek NT72172 A64 Turnkey Android Board"

config NT72172_A32_TK_ANDROID
	bool "Novatek NT72172 A32 Turnkey Android Board"

config NT72172_A32_TK_ANDROID_OPERA
	bool "Novatek NT72172 A32 Turnkey Android HbbTV Board"

config NT72172_A32_TK_ANDROID_OREO
	bool "Novatek NT72172 A32 Turnkey Android Oreo Board"

config NT72673_A32_EMMC_EVB
	bool "Novatek NT72673 A32 EMMC Evulation Board"	

config NT72673_A32_EMMC_CHINA_DRM
	bool "Novatek NT72673 A32 EMMC China DRM verify project"	
	
config NT72673_A64_EMMC_EVB
	bool "Novatek NT72673 A64 EMMC Evulation Board"	

config NT72673_A32_NAND_EVB
	bool "Novatek NT72673 A32 NAND Evulation Board"

config NT72673_N33005_NAND
	bool "Novatek NT72673 N33005 NAND Project Board"

config NT72673_A32_TK_ANDROID_OREO
	bool "Novatek NT72673 A32 Turnkey Android Oreo Board"

config NT72673_A32_TK_ANDROID_OREO_SEC
	bool "Novatek NT72673 A32 Turnkey Android Oreo Board With secure boot"

config N69004_A32_ANDROID_OREO
	bool "N69004 A32 Android Oreo Broad"

config N62002_A32_ANDROID_OREO
	bool "N62002 A32 Android Oreo Board"

config N62002_A32_ANDROID_OREO_SEC
	bool "N62002 A32 Android Oreo Board With secure boot"

config NT72673_A64_TK_ANDROID_OREO
	bool "Novatek NT72673 A64 Turnkey Android Oreo Board"

config NT72671_A32_EMMC_EVB
	bool "Novatek NT72671 A32 EMMC Evulation Board"	

config NT72671_A32_TK_ANDROID_OREO
	bool "Novatek NT72671 A32 Turnkey Android Oreo Board"
endchoice

config NVT_TK_EMMC_UTILS
	bool "Support Novatek Turnkey emmc utilitys"
	help
	   Support Novatek Turnkey emmc utiltys,
	   include gpt partition layout and firmware update commands

config NVT_FW_UPDATE_BUF_MAX
   	int "Maximum transfer dram buffer in Mega byte"
	depends on NVT_TK_EMMC_UTILS
	default "450"
	help
	   If update image large than available dram size, we need cut the image into serval piece to transfer
	   this value depend on your system available memory

config NVT_TK_SPI_UTILS
	bool "Support Novatek Turnkey SPI flash utilitys"
	help
	   Support Novatek Turnkey SPI flash utiltys,
	   include gpt partition layout and firmware update commands

config NVT_TK_NAND_UTILS
	bool "Support Novatek Turnkey NAND utilitys"
	help
	   Support Novatek Turnkey NAND utiltys,
	   include partition layout and firmware update commands

config NVT_EUPM
	bool "Support Novatek Emmc image dump utility"
	help
	   Support Novatek Emmc image dump utility


config NVTTK_EBURNER_V2
	bool "Support Novatek Turnkey Empty burner V2 utilitys"
	help
	   Support Novatek Turnkey Empty burner V2 utilitys

config NVTTK_EBURNER_V2_PACK_EBURNER
	bool "Pack nvttk_eburner into firmware"
	depends on NVTTK_EBURNER_V2
	help
	  Pack nvttk_eburner into firmware

config NVTTK_NO_EBURNER
	bool "Don't run Novatek eburner flow"
	depends on !NVTTK_EBURNER_V2
	default n
	help
	   Don't run Novatek eburner flow

config NVT_FM_TOOL
	bool "Support Novatek Turnkey Factory Mode burn key tool"
	select NVT_BOOTM_LOAD_SECOS
	help
	   Support Novatek Turnkey Factory Mode burn key tool

config NVT_BOOTM_LOAD_SECOS
	bool "Support Novatek uboot boot kernel with secos feature"
	help
	   Support Novatek uboot boot kernel with secos feature

config NVT_SECURE_BOOT
	bool "Support Novatek Turnkey secure boot solution"
	select SHA256
	help
	   Support Novatek Turnkey secure boot solution

config NVT_SECURE_SIGN_COMMON_FORMAT
	depends on NVT_SECURE_BOOT
	bool "Support Novatek Turnkey secure boot common sign format"
	help
	   Support Novatek Turnkey secure boot common sign format 

config NVT_NSV_SECURE_UPDATE
	bool "Support Novatek Turnkey NSV secure update solution"
	help
	   Support Novatek Turnkey NSV secure update solution

config OLD_PANEL_PARAM
	bool "Use old panel param format"
	default y
	help
	   Use old panel param format

config PARTITIONS
	bool "Support uboot partition function"
	depends on NVT_GWRITE 
	help
		Support uboot partition function

config EFI_PARTITION
	bool "Support uboot efi partition"
	depends on NVT_GWRITE 
	help
		Support uboot efi partition function

config DOS_PARTITION
	bool "Support uboot dos partition "
	default y
	help
		Support uboot dos partition function

config CMD_GPT 
	bool "Support uboot GPT function"
	depends on NVT_GWRITE 
	help
		Support uboot GPT function

config PARTITION_UUIDS 
	bool "Support uboot partition uuids"
	depends on NVT_GWRITE 
	help
		Support uboot partition uuids function

config NVT_GWRITE
	bool "Support Novatek gwrite utilitys"
	select PARTITIONS
	select EFI_PARTITION
	select DOS_PARTITION
	select CMD_GPT
  select PARTITION_UUIDS
	help
	   Support Novatek gwrite flash utiltys
	   include gpt partition layout and firmware update commands

config ANDROID_AB_UPDATE
	bool "Support Android AB update"
	default n

endmenu		# Novatek Features
endif
```

## board/novatek/n62002_a32_android_oreo/Kconfig
```kconfig
if N62002_A32_ANDROID_OREO

config SYS_BOARD
	default "n62002_a32_android_oreo"

config SYS_VENDOR
	default "novatek"

config SYS_SOC
	default "nt72673_a32"

config SYS_CONFIG_NAME
	default "n62002_a32_android_oreo"

endif
```

## board/novatek/n62002_a32_android_oreo_sec/Kconfig
```kconfig
if N62002_A32_ANDROID_OREO_SEC

config SYS_BOARD
	default "n62002_a32_android_oreo_sec"

config SYS_VENDOR
	default "novatek"

config SYS_SOC
	default "nt72673_a32"

config SYS_CONFIG_NAME
	default "n62002_a32_android_oreo_sec"

endif
```

## board/novatek/n69004_a32_android_oreo/Kconfig
```kconfig
if N69004_A32_ANDROID_OREO

config SYS_BOARD
	default "n69004_a32_android_oreo"

config SYS_VENDOR
	default "novatek"

config SYS_SOC
	default "nt72673_a32"

config SYS_CONFIG_NAME
	default "n69004_a32_android_oreo"

endif
```

## board/novatek/nt72172_a32_evb/Kconfig
```kconfig
if NT72172_A32_EVB

config SYS_BOARD
	default "nt72172_a32_evb"

config SYS_VENDOR
	default "novatek"

config SYS_SOC
	default "nt72172_a32"

config SYS_CONFIG_NAME
	default "nt72172_a32_emmc"

endif
```

## board/novatek/nt72172_a32_tk_android/Kconfig
```kconfig
if NT72172_A32_TK_ANDROID

config SYS_BOARD
	default "nt72172_a32_tk_android"

config SYS_VENDOR
	default "novatek"

config SYS_SOC
	default "nt72172_a32"

config SYS_CONFIG_NAME
	default "nt72172_a32_tk_android"

endif
```

## board/novatek/nt72172_a64_evb/Kconfig
```kconfig
if NT72172_A64_EVB

config SYS_BOARD
	default "nt72172_a64_evb"

config SYS_VENDOR
	default "novatek"

config SYS_SOC
	default "nt72172_a64"

config SYS_CONFIG_NAME
	default "nt72172_a64_emmc"

endif
```

## board/novatek/nt72172_a64_tk_android/Kconfig
```kconfig
if NT72172_A64_TK_ANDROID

config SYS_BOARD
	default "nt72172_a64_tk_android"

config SYS_VENDOR
	default "novatek"

config SYS_SOC
	default "nt72172_a64"

config SYS_CONFIG_NAME
	default "nt72172_a64_tk_android"

endif
```

## board/novatek/nt72671_a32_emmc_evb/Kconfig
```kconfig
if NT72671_A32_EMMC_EVB

config SYS_BOARD
	default "nt72671_a32_emmc_evb"

config SYS_VENDOR
	default "novatek"

config SYS_SOC
	default "nt72671_a32"

config SYS_CONFIG_NAME
	default "nt72671_a32_emmc"

endif
```

## board/novatek/nt72671_a32_tk_android_oreo/Kconfig
```kconfig
if NT72671_A32_TK_ANDROID_OREO

config SYS_BOARD
	default "nt72671_a32_tk_android_oreo"

config SYS_VENDOR
	default "novatek"

config SYS_SOC
	default "nt72671_a32"

config SYS_CONFIG_NAME
	default "nt72671_a32_tk_android_oreo"

endif
```

## board/novatek/nt72673_a32_emmc_china_drm/Kconfig
```kconfig
if NT72673_A32_EMMC_CHINA_DRM

config SYS_BOARD
	default "nt72673_a32_emmc_china_drm"

config SYS_VENDOR
	default "novatek"

config SYS_SOC
	default "nt72673_a32"

config SYS_CONFIG_NAME
	default "nt72673_a32_emmc_china_drm"

endif
```

## board/novatek/nt72673_a32_emmc_evb/Kconfig
```kconfig
if NT72673_A32_EMMC_EVB

config SYS_BOARD
	default "nt72673_a32_emmc_evb"

config SYS_VENDOR
	default "novatek"

config SYS_SOC
	default "nt72673_a32"

config SYS_CONFIG_NAME
	default "nt72673_a32_emmc"

endif
```

## board/novatek/nt72673_a32_nand_evb/Kconfig
```kconfig
if NT72673_A32_NAND_EVB

config SYS_BOARD
	default "nt72673_a32_nand_evb"

config SYS_VENDOR
	default "novatek"

config SYS_SOC
	default "nt72673_a32"

config SYS_CONFIG_NAME
	default "nt72673_a32_nand_evb"

endif
```

## board/novatek/nt72673_a32_tk_android_oreo_sec/Kconfig
```kconfig
if NT72673_A32_TK_ANDROID_OREO_SEC

config SYS_BOARD
	default "nt72673_a32_tk_android_oreo_sec"

config SYS_VENDOR
	default "novatek"

config SYS_SOC
	default "nt72673_a32"

config SYS_CONFIG_NAME
	default "nt72673_a32_tk_android_oreo_sec"

endif
```

## board/novatek/nt72673_a64_emmc_evb/Kconfig
```kconfig
if NT72673_A64_EMMC_EVB

config SYS_BOARD
	default "nt72673_a64_emmc_evb"

config SYS_VENDOR
	default "novatek"

config SYS_SOC
	default "nt72673_a64"

config SYS_CONFIG_NAME
	default "nt72673_a64_emmc"

endif
```

## board/novatek/nt72673_a64_tk_android_oreo/Kconfig
```kconfig
if NT72673_A64_TK_ANDROID_OREO

config SYS_BOARD
	default "nt72673_a64_tk_android_oreo"

config SYS_VENDOR
	default "novatek"

config SYS_SOC
	default "nt72673_a64"

config SYS_CONFIG_NAME
	default "nt72673_a64_tk_android_oreo"

endif
```

## board/novatek/nt72673_n33005_nand/Kconfig
```kconfig
if NT72673_N33005_NAND

config SYS_BOARD
	default "nt72673_n33005_nand"

config SYS_VENDOR
	default "novatek"

config SYS_SOC
	default "nt72673_a32"

config SYS_CONFIG_NAME
	default "nt72673_n33005_nand"

# Project configs

menuconfig CMD_NVT_SCRIPT_UPDATE
	bool "Upgrade firmware according to auto script"
	default n

if CMD_NVT_SCRIPT_UPDATE

config NVT_SCRIPT_UPDATE_SKIP_CHECK
	bool "Skip check script"

config NVT_SCRIPT_UPDATE_BLINK_LED
	bool "Blink LED while updating"

config NVT_SCRIPT_UPDATE_SCRIPT_NAME
	string "Default script file name"
	default "shredder_usb_update.scr"

config NVT_SCRIPT_UPDATE_BUF
	hex "Script ram buffer address"
	default 0x3200000

config NVT_SCRIPT_UPDATE_SIZE
	int "Script file size"
	default 8192

endif

config FRC_UTILS
	bool "FRC utils support"
	default n

endif
```

## board/novatek/nvt-na51000/Kconfig
```kconfig
if ARCH_NA51000_A32

config SYS_BOARD
	default "nvt-na51000"

config SYS_SOC
	default "nvt-na51000"

config SYS_VENDOR
	default "novatek"

config SYS_CONFIG_NAME
	default "nvt-na51000-evb"

endif
```

## drivers/mtd/nand/nt72_nand/Kconfig
```kconfig
config NVT_NAND_FLASH_CONTROLLER
	tristate "Support for NT72xxx NAND Flash Controller"
	default n
	help
	  Enable support for Novatek NT72xxx NAND Flash Controller.

config NVT_NAND_FLASH_CONTROLLER_BBT
	bool "Enable BBT on NT72xxx NAND Flash Controller"
	depends on MTD
	depends on NVT_NAND_FLASH_CONTROLLER
	default y
	help
	  Enable on device bad block table (BBT). The on device BBT has extra
	  checksum protection.
	  Please noted that this option is for Novatek NT72xxx NAND Flash
	  Controller only.

config NVT_NAND_FLASH_CONTROLLER_BITFLIP_THRESHOLD
	int "Customize MTD bitflip threshold"
	depends on MTD
	depends on NVT_NAND_FLASH_CONTROLLER
	default 3
	help
	  Assign the bitflip threshold value for MTD.  This value controls how
	  bitflip error is returned to UBI. Only if the bitflip count is greater
	  then this threshold, then UBI get the bitflip error.
	  Set 0 to let system select the optimal value by ECC algorithm.
	  The default value is 3 for optimal RS4 configuration.

config NVT_NAND_FLASH_CONTROLLER_SHARE_CI
	tristate "Share GPIOs with CI controller (ARM-side NFC)"
	depends on NVT_NAND_FLASH_CONTROLLER
	default n
	help
	  Enable support for GPIO pin sharing between Novatek NT72xxx NAND Flash
	  Controller and CI.
	  Please noted that this option should be used for Novatek NT72xxx NAND
	  Flash Controller only.

config NVT_NAND_FLASH_CONTROLLER_STBC_ECC_SWITCH
	tristate "Support for STBC partition ECC switch"
	depends on MTD
	depends on NVT_NAND_FLASH_CONTROLLER
	default n
	help
	  A workaround implementation to switch ECC when access STBC partition,
	  so we can completely ignore the incorrect ECC bootstrap setting.
	  Please noted that this option should be used for Novatek NT72xxx NAND
	  Flash Controller only.

config NVT_NAND_FLASH_CONTROLLER_BY_PART_ECC_INV
        tristate "Support for by-partition ECC inversion"
        depends on NVT_NAND_FLASH_CONTROLLER
        depends on NVT_NAND_FLASH_CONTROLLER_NPT
        default n
        help
          Enable ECC inversion for page read and page program for all blocks
          from partition name contains "_inv", "ap", "fs", "pridat". Internally,
          a table will be created to indicate if one block needs ECC inversion
          during driver initialization. By using ECC inversion makes blank pages
          protected by ECC.
          Please noted that this option should be used for Novatek NT72171
          (or newer) NAND Flash Controller.

config NVT_NAND_FLASH_CONTROLLER_NPT
	tristate "Support for Novatek Partition Table"
	depends on NVT_NAND_FLASH_CONTROLLER
	default y
	help
	  Enable supports for the on-NAND partition table.
	  During driver initialization, the partition table on the MISC
	  partition will be read, verified and parsed for MTD.
	  Please noted that this option should be used for Novatek NT72171
	  (or newer) NAND Flash Controller.

config NVT_NAND_FLASH_CONTROLLER_MTD_DIRECT_DMA
	tristate "Support for memcpy-less MTD interface"
	depends on MTD
	depends on NVT_NAND_FLASH_CONTROLLER
	default n
	help
	  Skip internal NFC DMA buffer and transfer data to MTD buffer directly.
	  Currently only unaligned read is optimized, because other read/write
	  modes have no performance gains on NT72171 platform and vastly
	  increase the code complexity.

config NVT_NAND_FLASH_CONTROLLER_DEBUGFS
	tristate "Support for debugfs"
	depends on DEBUG_FS
	depends on NVT_NAND_FLASH_CONTROLLER
	default n
	help
	  Enable debugfs for the Novatek NT72xxx NAND Flash Controller to
	  commands used for special test cases.
	  Please noted that this option is for Novatek NT72xxx NAND Flash
	  Controller only.

config NVT_NAND_FLASH_CONTROLLER_QUIET
	tristate "Print less logs"
	depends on NVT_NAND_FLASH_CONTROLLER
	default n
	help
	  Skip some message and not to print them. Please be careful on this
	  option, since less messages make debugging impossible.
	  Please noted that this option is for Novatek NT72xxx NAND Flash
	  Controller only.
```

## drivers/nvt_stbc/Kconfig
```kconfig
menu "Novatek Stand By Controller Support"

config NVT_STBC
	bool "Enable Novatek STBC  support"
	depends on ARCH_NT72172_A32 || ARCH_NT72172_A64 || ARCH_NT72673_A32 || ARCH_NT72673_A64 || ARCH_NT72671_A32 || ARCH_NT72671_A64
	help
	  This enables Novatek stand by controller function support

endmenu
```
